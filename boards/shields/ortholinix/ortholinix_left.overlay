#include "ortholinix.dtsi"

&kscan0 {
    gpios
        = <&xiao_d 0 GPIO_ACTIVE_HIGH>
        , <&xiao_d 1 GPIO_ACTIVE_HIGH>
        , <&xiao_d 2 GPIO_ACTIVE_HIGH>
        , <&xiao_d 3 GPIO_ACTIVE_HIGH>
        , <&xiao_d 6 GPIO_ACTIVE_HIGH>
        , <&xiao_d 7 GPIO_ACTIVE_HIGH>
        , <&xiao_d 8 GPIO_ACTIVE_HIGH>
        ;
};

&left_encoder {
    status = "okay";
};

/ {
    sensors: sensors {
        compatible = "zmk,keymap-sensors";
        sensors = <&left_encoder>;
        triggers-per-rotation = <20>;
    };
};
