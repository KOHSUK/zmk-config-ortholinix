## boards/shields/ortholinix/Kconfig.defconfig
```kconfig
if SHIELD_ORTHOLINIX_LEFT

# Name must be less than 16 characters long!
config ZMK_KEYBOARD_NAME
    default "Ortholinix"

config ZMK_SPLIT
    default y

config ZMK_SPLIT_ROLE_CENTRAL
    default y

endif

if SHIELD_ORTHOLINIX_LEFT || SHIELD_ORTHOLINIX_RIGHT

config ZMK_SPLIT
    default y

endif
```

## boards/shields/ortholinix/Kconfig.shield
```kconfig
config SHIELD_ORTHOLINIX_LEFT
    def_bool $(shields_list_contains,ortholinix_left)

config SHIELD_ORTHOLINIX_RIGHT
    def_bool $(shields_list_contains,ortholinix_right)
```
